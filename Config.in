## Config.in
```kconfig
source "$BR2_EXTERNAL_SOSE_PATH/package/svmd/Config.in"
source "$BR2_EXTERNAL_SOSE_PATH/package/svm/Config.in"
```

## configs/sose_dom0_defconfig
```kconfig
BR2_aarch64=y
BR2_PACKAGE_HOST_LINUX_HEADERS_CUSTOM_6_18=y
BR2_PACKAGE_OVERRIDE_FILE="$(BR2_EXTERNAL_SOSE_PATH)/local.mk"
BR2_GLOBAL_PATCH_DIR="board/qemu/patches"
BR2_DOWNLOAD_FORCE_CHECK_HASHES=y
BR2_ROOTFS_OVERLAY="$(BR2_EXTERNAL_SOSE_PATH)/board/dom0/rootfs-overlay"
BR2_ROOTFS_POST_BUILD_SCRIPT="$(BR2_EXTERNAL_SOSE_PATH)/board/dom0/post-build.sh"
BR2_ROOTFS_POST_IMAGE_SCRIPT="board/qemu/post-image.sh"
BR2_ROOTFS_POST_SCRIPT_ARGS="$(BR2_DEFCONFIG)"
BR2_LINUX_KERNEL=y
BR2_LINUX_KERNEL_CUSTOM_VERSION=y
BR2_LINUX_KERNEL_CUSTOM_VERSION_VALUE="6.18.7"
BR2_LINUX_KERNEL_USE_CUSTOM_CONFIG=y
BR2_LINUX_KERNEL_CUSTOM_CONFIG_FILE="board/qemu/aarch64-virt/linux.config"
BR2_LINUX_KERNEL_CONFIG_FRAGMENT_FILES="$(BR2_EXTERNAL_SOSE_PATH)/board/dom0/linux-xen.config"
BR2_LINUX_KERNEL_INSTALL_TARGET=y
BR2_LINUX_KERNEL_NEEDS_HOST_OPENSSL=y
BR2_PACKAGE_SOCAT=y
BR2_PACKAGE_XEN=y
BR2_PACKAGE_XEN_TOOLS=y
BR2_TARGET_ROOTFS_CPIO=y
BR2_TARGET_ROOTFS_CPIO_GZIP=y
# BR2_TARGET_ROOTFS_TAR is not set
BR2_PACKAGE_SVMD=y
BR2_PACKAGE_SVM=y
```

## configs/sose_guest_defconfig
```kconfig
BR2_aarch64=y
BR2_PACKAGE_HOST_LINUX_HEADERS_CUSTOM_6_18=y
BR2_DOWNLOAD_FORCE_CHECK_HASHES=y
BR2_TARGET_GENERIC_HOSTNAME="guest"
BR2_TARGET_GENERIC_ISSUE="SoseOS guest"
BR2_TARGET_GENERIC_GETTY_PORT="hvc0"
BR2_ROOTFS_OVERLAY="$(BR2_EXTERNAL_SOSE_PATH)/board/guest/rootfs-overlay"
BR2_TARGET_ROOTFS_CPIO=y
BR2_TARGET_ROOTFS_CPIO_GZIP=y
# BR2_TARGET_ROOTFS_TAR is not set
```

## configs/sose_netvm_defconfig
```kconfig
BR2_aarch64=y
BR2_PACKAGE_HOST_LINUX_HEADERS_CUSTOM_6_18=y
BR2_PACKAGE_OVERRIDE_FILE="$(BR2_EXTERNAL_SOSE_PATH)/local.mk"
BR2_DOWNLOAD_FORCE_CHECK_HASHES=y
BR2_TARGET_GENERIC_HOSTNAME="netvm"
BR2_TARGET_GENERIC_ISSUE="SoseOS netvm"
BR2_TARGET_GENERIC_GETTY_PORT="hvc0"
BR2_ROOTFS_OVERLAY="$(BR2_EXTERNAL_SOSE_PATH)/board/guest/rootfs-overlay $(BR2_EXTERNAL_SOSE_PATH)/board/netvm/rootfs-overlay"
BR2_ROOTFS_POST_BUILD_SCRIPT="$(BR2_EXTERNAL_SOSE_PATH)/board/netvm/post-build.sh"
BR2_PACKAGE_BUSYBOX_CONFIG_FRAGMENT_FILES="$(BR2_EXTERNAL_SOSE_PATH)/board/netvm/busybox.fragment"
BR2_PACKAGE_NFTABLES=y
BR2_PACKAGE_XEN=y
BR2_PACKAGE_XEN_TOOLS=y
BR2_TARGET_ROOTFS_CPIO=y
BR2_TARGET_ROOTFS_CPIO_GZIP=y
# BR2_TARGET_ROOTFS_TAR is not set
```

## package/svm-ls/Config.in
```kconfig
config BR2_PACKAGE_SVM_LS
	bool "svm-ls"
	depends on BR2_PACKAGE_HOST_RUSTC_TARGET_ARCH_SUPPORTS
	select BR2_PACKAGE_HOST_RUSTC
	help
	  Lists running Xen domains and their names by talking to
	  xenstored over its Unix socket.
```

## package/svm/Config.in
```kconfig
config BR2_PACKAGE_SVM
	bool "svm"
	depends on BR2_PACKAGE_HOST_RUSTC_TARGET_ARCH_SUPPORTS
	select BR2_PACKAGE_HOST_RUSTC
	help
	  Command line client for svmd: svm list, svm start <name>,
	  svm stop <name>.
```

## package/svmd/Config.in
```kconfig
config BR2_PACKAGE_SVMD
	bool "svmd"
	depends on BR2_PACKAGE_HOST_RUSTC_TARGET_ARCH_SUPPORTS
	select BR2_PACKAGE_HOST_RUSTC
	help
	  SoseOS VM manager daemon: starts and stops VMs on request
	  from tools over /run/svmd.sock.
```
